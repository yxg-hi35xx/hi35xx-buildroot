## configs/hi3518v200_defconfig
```kconfig
BR2_arm=y
BR2_KERNEL_MIRROR="https://www.kernel.org/pub"
BR2_GNU_MIRROR="http://ftp.gnu.org/pub/gnu"
BR2_ENABLE_DEBUG=y
BR2_OPTIMIZE_2=y
BR2_GLOBAL_PATCH_DIR="board/yxgtech/hi3518v200/patches"
# BR2_COMPILER_PARANOID_UNSAFE_PATH is not set
BR2_KERNEL_HEADERS_VERSION=y
BR2_DEFAULT_KERNEL_VERSION="3.4.35"
BR2_PACKAGE_HOST_LINUX_HEADERS_CUSTOM_3_4=y
BR2_TOOLCHAIN_BUILDROOT_INET_RPC=y
BR2_TOOLCHAIN_BUILDROOT_WCHAR=y
BR2_PTHREAD_DEBUG=y
BR2_TOOLCHAIN_BUILDROOT_USE_SSP=y
# BR2_UCLIBC_INSTALL_UTILS is not set
BR2_GCC_VERSION_6_X=y
BR2_TOOLCHAIN_BUILDROOT_CXX=y
BR2_GCC_ENABLE_LTO=y
BR2_GCC_ENABLE_GRAPHITE=y
BR2_PACKAGE_HOST_GDB=y
BR2_PACKAGE_HOST_GDB_TUI=y
BR2_GDB_VERSION_7_12=y
BR2_TARGET_GENERIC_HOSTNAME="ipcam"
BR2_TARGET_GENERIC_ISSUE="Welcome to hi35xx-buildroot"
BR2_ROOTFS_DEVICE_CREATION_DYNAMIC_MDEV=y
BR2_TARGET_GENERIC_ROOT_PASSWD="yxgtech-2016"
# BR2_ENABLE_LOCALE_PURGE is not set
BR2_ROOTFS_OVERLAY="board/yxgtech/hi3518v200/fs-overlay"
BR2_ROOTFS_POST_BUILD_SCRIPT="board/yxgtech/hi3518v200/post-build.sh"
BR2_ROOTFS_POST_IMAGE_SCRIPT="board/yxgtech/hi3518v200/post-image.sh"
BR2_ROOTFS_POST_SCRIPT_ARGS="kernel uImage rootfs rootfs.squashfs"
BR2_LINUX_KERNEL=y
BR2_LINUX_KERNEL_CUSTOM_LOCAL=y
BR2_LINUX_KERNEL_CUSTOM_LOCAL_PATH="linux/linux-3.4.y"
BR2_LINUX_KERNEL_USE_CUSTOM_CONFIG=y
BR2_LINUX_KERNEL_CUSTOM_CONFIG_FILE="board/yxgtech/hi3518v200/linux-3.4.config"
BR2_LINUX_KERNEL_UIMAGE=y
BR2_LINUX_KERNEL_XZ=y
BR2_PACKAGE_BUSYBOX_CONFIG="board/yxgtech/hi3518v200/busybox.config"
BR2_PACKAGE_BUSYBOX_WATCHDOG=y
BR2_PACKAGE_LIVE_STREAMER=y
BR2_PACKAGE_EXFAT_NOFUSE=y
BR2_PACKAGE_EXFAT_UTILS=y
BR2_PACKAGE_BITSTREAM_VERA=y
BR2_PACKAGE_HII2C=y
BR2_PACKAGE_HIMPP=y
BR2_PACKAGE_HIMPP_HI3518V200=y
BR2_PACKAGE_MT7601U=y
BR2_PACKAGE_UBOOT_TOOLS=y
BR2_PACKAGE_LUAJIT=y
BR2_PACKAGE_LUA_PERIPHERY=y
BR2_PACKAGE_LUAJSON=y
BR2_PACKAGE_SIMPLEDBUS=y
BR2_PACKAGE_WSAPI_FCGI=y
BR2_PACKAGE_JSONCPP=y
# BR2_PACKAGE_LIVE555_MEDIA_SERVER is not set
# BR2_PACKAGE_LIVE555_PROXY_SERVER is not set
BR2_PACKAGE_GMP=y
BR2_PACKAGE_FCGIWRAP=y
BR2_PACKAGE_HIAWATHA=y
BR2_PACKAGE_SPAWN_FCGI=y
BR2_PACKAGE_WPA_SUPPLICANT=y
BR2_PACKAGE_WPA_SUPPLICANT_AUTOSCAN=y
BR2_PACKAGE_WPA_SUPPLICANT_DEBUG_SYSLOG=y
BR2_PACKAGE_WPA_SUPPLICANT_CLI=y
BR2_PACKAGE_WPA_SUPPLICANT_WPA_CLIENT_SO=y
BR2_PACKAGE_TUTK_SERVER=y
BR2_PACKAGE_WIFI_CONFIG=y
BR2_TARGET_ROOTFS_SQUASHFS=y
BR2_TARGET_ROOTFS_SQUASHFS4_XZ=y
BR2_TARGET_ROOTFS_TAR_XZ=y
BR2_TARGET_UBOOT=y
BR2_TARGET_UBOOT_BOARDNAME="hi3518ev200"
BR2_TARGET_UBOOT_CUSTOM_LOCAL=y
BR2_TARGET_UBOOT_CUSTOM_LOCAL_PATH="boot/uboot/u-boot-2010.06"
BR2_TARGET_UBOOT_HI35XX_IMAGE=y
BR2_TARGET_UBOOT_HI35XX_IMAGE_CH_FILE="board/yxgtech/hi3518v200/boot/reg_info_hi3518ev200.bin"
BR2_TARGET_UBOOT_ENVIMAGE=y
BR2_TARGET_UBOOT_ENVIMAGE_SOURCE="board/yxgtech/hi3518v200/uboot-env.txt"
BR2_TARGET_UBOOT_ENVIMAGE_SIZE="0x20000"
```

## package/hii2c/Config.in
```kconfig
config BR2_PACKAGE_HII2C
	bool "hii2c"
	help
	  I2C read/write tools for hisilicon platform.
```

## package/live-streamer/Config.in
```kconfig
config BR2_PACKAGE_LIVE_STREAMER
	bool "live-streamer"
	depends on BR2_TOOLCHAIN_HAS_THREADS
	depends on BR2_USE_MMU # fork()
	depends on !BR2_STATIC_LIBS
	depends on BR2_INSTALL_LIBSTDCPP
	select BR2_PACKAGE_LIBEV
	select BR2_PACKAGE_DBUS
	select BR2_PACKAGE_DBUS_CPP
	select BR2_PACKAGE_LIVE555
	select BR2_PACKAGE_FONTCONFIG
	select BR2_PACKAGE_SDL
	select BR2_PACKAGE_SDL_TTF
	select BR2_PACKAGE_SDL_IMAGE
	help
	  live-streamer is a RTP/RTSP stream server, provide D-Bus
	  control interface. support hi3518 SoC.

	  https://github.com/hi35xx/live-streamer

comment "live-streamer needs a toolchain w/ threads, dynamic library"
	depends on !BR2_TOOLCHAIN_HAS_THREADS || BR2_STATIC_LIBS
	depends on BR2_USE_MMU

if BR2_PACKAGE_LIVE_STREAMER

config BR2_PACKAGE_LIVE_STREAMER_OSD
	bool "enable osd support"
	default y
	help
	  Enable osd support for live streamer. For reduce memory usage 
	  on hi3518e v201, osd should be disabled.

endif
```

## package/mt7601u/Config.in
```kconfig
comment "mt7601u needs a Linux kernel to be built"
	depends on !BR2_LINUX_KERNEL

config BR2_PACKAGE_MT7601U
	bool "mt7601u"
	depends on BR2_LINUX_KERNEL
	help
	  USB Wireless driver for MediaTek mt7601u chip
```

## package/yxgtech/Config.in
```kconfig
source "package/yxgtech/ttxserver/Config.in"
source "package/yxgtech/tutk-server/Config.in"
source "package/yxgtech/wifi-config/Config.in"
source "package/yxgtech/snapshotd/Config.in"
source "package/yxgtech/openrtsp/Config.in"
```

## package/yxgtech/openrtsp/Config.in
```kconfig
config BR2_PACKAGE_OPENRTSP
	bool "openRTSP"
	select BR2_PACKAGE_LIVE555
	help
	  A RTSP client application that opens a RTSP URL argument,
	  and extracts and records the data from each incoming RTP stream.
```

## package/yxgtech/ttxserver/Config.in
```kconfig
config BR2_PACKAGE_TTXSERVER
	bool "ttxserver"
	depends on BR2_TOOLCHAIN_HAS_THREADS
	depends on BR2_USE_MMU # fork()
	help
	  ttxserver is a P2P server for ttxnet platform.

comment "ttxserver needs a toolchain w/ threads"
	depends on !BR2_TOOLCHAIN_HAS_THREADS
```

## package/yxgtech/tutk-server/Config.in
```kconfig
config BR2_PACKAGE_TUTK_SERVER
	bool "tutk-server"
	depends on BR2_TOOLCHAIN_HAS_THREADS
	depends on BR2_USE_MMU # fork()
	select BR2_PACKAGE_DBUS_CPP
	select BR2_PACKAGE_LIVE555
	help
	  Tutk server is a P2P server for TUTK platform.

comment "tutk-server needs a toolchain w/ threads"
	depends on !BR2_TOOLCHAIN_HAS_THREADS
```

## package/yxgtech/wifi-config/Config.in
```kconfig
config BR2_PACKAGE_WIFI_CONFIG
	bool "wifi-config"
	depends on BR2_TOOLCHAIN_HAS_THREADS
	depends on BR2_USE_MMU # fork()
	help
	  wifi-config is a wifi config utilities for mt7601u wifi adapter,
	  include ELIAN smartlink technology.

comment "wifi-config needs a toolchain w/ threads"
	depends on !BR2_TOOLCHAIN_HAS_THREADS
```
